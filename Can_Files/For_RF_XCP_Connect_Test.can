/*@!Encoding:65001*/
includes
{
  #include ".\adas_sim\99_SUBM\fd3_test_common_lib\99_SUBM\test_common_lib\CAPL_includes\XCP\XCP_Generic.can"
}

variables
{
  char ECU_name[10]="APU";
  char var_name[100];
  long connectionTimeout = 5000;   // Timeout in ms
  int64 status_xcp=0;
}




void MainTest ()
{
   @sysvar::Obejct_Vehicle_Speed::XCP_Connection_Success=0;
   testWaitForTimeout(5);
   cTF_Activate_XCP_Read_DAQ(var_name,ECU_name,connectionTimeout);
   testWaitForTimeout(1);
   cTF_Connect_XCP(ECU_name,connectionTimeout);
   testWaitForTimeout(4);

   status_xcp=xcpIsConnected(ECU_name);
   if(status_xcp==1)
   {
     @sysvar::Obejct_Vehicle_Speed::XCP_Connection_Success=1;
     testWaitForTimeout(1);
   }
   
    
}

