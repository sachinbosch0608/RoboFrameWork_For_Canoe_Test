/*@!Encoding:65001*/
includes
{
  #include ".\adas_sim\99_SUBM\fd3_test_common_lib\99_SUBM\test_common_lib\CAPL_includes\XCP\XCP_Generic.can"
}

variables
{
  char ECU_name[10]="APU";
  char var_name[100];
  long connectionTimeout = 5000;   // Timeout in ms
  int64 status_xcp=0;
}

	


void MainTest ()
{
   @sysvar::Obejct_Vehicle_Speed::XCP_Connection_Failed=0;
   cTF_Disconnect_XCP(ECU_name,connectionTimeout);
   //testWaitForTimeout(1);
  // cTF_Deativate_XCP_Read_DAQ(var_name,ECU_name,connectionTimeout); 
   testWaitForTimeout(1);
   status_xcp=xcpIsConnected(ECU_name);
   if(status_xcp==0)
   {
     @sysvar::Obejct_Vehicle_Speed::XCP_Connection_Failed=1;
     testWaitForTimeout(1);
   }
}

